// SPDX-License-Identifier: (GPL-2.0+ OR MIT)

/dts-v1/;

#include <dt-bindings/gpio/gpio.h>
#include <dt-bindings/clock/rk3588-cru.h>
#include <dt-bindings/interrupt-controller/irq.h>
#include <dt-bindings/power/rk3588-power.h>
#include <dt-bindings/pwm/pwm.h>
#include <dt-bindings/pinctrl/rockchip.h>
#include <dt-bindings/input/linux-event-codes.h>
#include <dt-bindings/display/drm_mipi_dsi.h>
#include <dt-bindings/display/rockchip_vop.h>
#include <dt-bindings/usb/pd.h>
#include "rk3588.dtsi"
#include "rk3588-rk806-single.dtsi"
#include "rk3588-linux.dtsi"

/ {
	model = "CHMAYCO RK3588 Livestream Box";

	compatible = "chmayco,rk3588-livestream", "rockchip,rk3588";

	adc_keys: adc-keys {
		compatible = "adc-keys";
		io-channel-names = "buttons";
		keyup-threshold-microvolt = <1800000>;
		io-channels = <&saradc 0x01>;
		poll-interval = <100>;

		vol-down-key {
			linux,code = <KEY_VOLUMEDOWN>;
			press-threshold-microvolt = <417000>;
			label = "volume down";
		};

		back-key {
			linux,code = <158>;	/* vendor key */
			press-threshold-microvolt = <1235000>;
			label = "back";
		};

		menu-key {
			linux,code = <139>;	/* vendor key */
			press-threshold-microvolt = <890000>;
			label = "menu";
		};

		vol-up-key {
			linux,code = <KEY_VOLUMEUP>;
			press-threshold-microvolt = <17000>;
			label = "volume up";
		};
	};

	aliases {
		mmc0 = &sdhci;
		mmc1 = &sdmmc;
		mmc2 = &sdio;
	};

	backlight: backlight {
		compatible = "pwm-backlight";
		status = "okay";
		pwms = <&pwm1 0x00 0xf4240 0x00>;
		brightness-levels = <
			  0  20  20  21  21  22  22  23
			 23  24  24  25  25  26  26  27
			 27  28  28  29  29  30  30  31
			 31  32  32  33  33  34  34  35
			 35  36  36  37  37  38  38  39
			 40  41  42  43  44  45  46  47
			 48  49  50  51  52  53  54  55
			 56  57  58  59  60  61  62  63
			 64  65  66  67  68  69  70  71
			 72  73  74  75  76  77  78  79
			 80  81  82  83  84  85  86  87
			 88  89  90  91  92  93  94  95
			 96  97  98  99 100 101 102 103
			104 105 106 107 108 109 110 111
			112 113 114 115 116 117 118 119
			120 121 122 123 124 125 126 127
			128 129 130 131 132 133 134 135
			136 137 138 139 140 141 142 143
			144 145 146 147 148 149 150 151
			152 153 154 155 156 157 158 159
			160 161 162 163 164 165 166 167
			168 169 170 171 172 173 174 175
			176 177 178 179 180 181 182 183
			184 185 186 187 188 189 190 191
			192 193 194 195 196 197 198 199
			200 201 202 203 204 205 206 207
			208 209 210 211 212 213 214 215
			216 217 218 219 220 221 222 223
			224 225 226 227 228 229 230 231
			232 233 234 235 236 237 238 239
			240 241 242 243 244 245 246 247
			248 249 250 251 252 253 254 255
		>;
		enable-gpios = <&gpio2 RK_PC1 GPIO_ACTIVE_HIGH>;
		pinctrl-names = "default";
		default-brightness-level = <200>;
		pinctrl-0 = <&backlight_en>;
	};

	chosen {
		stdout-path = "serial2:1500000n8";
		/* Do not inherit Android's fixed root=PARTUUID. */
		/delete-property/ bootargs;
	};

	dp0_sound: dp0-sound {
		compatible = "rockchip,hdmi";
		status = "okay";
		rockchip,mclk-fs = <512>;
		rockchip,jack-det;
		rockchip,codec = <&dp0 &gic>;
		rockchip,card-name = "rockchip,dp0";
		rockchip,cpu = <&spdif_tx2>;
	};

	dp1_sound: dp1-sound {
		compatible = "rockchip,hdmi";
		status = "disabled";
		rockchip,mclk-fs = <512>;
		rockchip,jack-det;
		rockchip,codec = <&dp1 &gic>;
		rockchip,card-name = "rockchip,dp1";
		rockchip,cpu = <&spdif_tx5>;
	};

	es8388_sound: es8388-sound {
		compatible = "rockchip,multicodecs-card";
		status = "okay";
		rockchip,mclk-fs = <256>;
		io-channel-names = "adc-detect";
		keyup-threshold-microvolt = <1800000>;
		hp-det-gpio = <&gpio1 RK_PC4 GPIO_ACTIVE_HIGH>;
		rockchip,audio-routing = 
			"Headphone", "LOUT1", 
			"Headphone", "ROUT1", 
			"Speaker", "LOUT2", 
			"Speaker", "ROUT2", 
			"Headphone", "Headphone Power", 
			"Headphone", "Headphone Power", 
			"Speaker", "Speaker Power", 
			"Speaker", "Speaker Power", 
			"LINPUT1", "Main Mic", 
			"LINPUT2", "Main Mic", 
			"RINPUT1", "Headset Mic", 
			"RINPUT2", "Headset Mic";
		hp-con-gpio = <&gpio4 RK_PA4 GPIO_ACTIVE_HIGH>;
		spk-con-gpio = <&gpio4 RK_PA3 GPIO_ACTIVE_HIGH>;
		rockchip,codec = <&es8388>;
		rockchip,format = "i2s";
		io-channels = <&saradc 0x03>;
		rockchip,card-name = "rockchip-es8388";
		pinctrl-names = "default";
		pinctrl-0 = <&hp_det>;
		rockchip,cpu = <&i2s0_8ch>;
		poll-interval = <100>;

		play-pause-key {
			linux,code = <KEY_PLAYPAUSE>;
			press-threshold-microvolt = <2000>;
			label = "playpause";
		};
	};

	gpio_keys: gpio-keys {
		compatible = "gpio-keys";
		autorepeat;
		pinctrl-names = "default";
		pinctrl-0 = <&gpiobtn>;

		KEY_up {
			linux,code = <KEY_VOLUMEUP>;
			label = "GPIO v+";
			gpios = <&gpio2 RK_PB0 GPIO_ACTIVE_LOW>;
			debounce-interval = <0x64>;
		};

		KEY_dn {
			linux,code = <KEY_VOLUMEDOWN>;
			label = "GPIO v-";
			gpios = <&gpio2 RK_PB1 GPIO_ACTIVE_LOW>;
			debounce-interval = <0x64>;
		};
	};

	hdmi0_sound: hdmi0-sound {
		compatible = "rockchip,hdmi";
		status = "disabled";
		rockchip,mclk-fs = <128>;
		rockchip,jack-det;
		rockchip,codec = <&hdmi0>;
		rockchip,card-name = "rockchip-hdmi0";
		rockchip,cpu = <&i2s5_8ch>;
	};

	hdmi1_sound: hdmi1-sound {
		compatible = "rockchip,hdmi";
		status = "okay";
		rockchip,mclk-fs = <128>;
		rockchip,jack-det;
		rockchip,codec = <&hdmi1>;
		rockchip,card-name = "rockchip-hdmi1";
		rockchip,cpu = <&i2s6_8ch>;
	};

	leds: leds {
		compatible = "gpio-leds";
		/* GPIO3_PB7 is also the GMAC1 PHY reset line in the factory DTB. */
		status = "disabled";

		work_led: work {
			linux,default-trigger = "heartbeat";
			gpios = <&gpio3 RK_PB7 GPIO_ACTIVE_HIGH>;
		};
	};

	memory@200000 {
		device_type = "memory";
		reg = <0x0 0x00200000 0x0 0x08200000>,
		      <0x0 0x09400000 0x0 0xe6c00000>,
		      <0x1 0x00000000 0x2 0xfc000000>,
		      <0x3 0xfc500000 0x0 0x03a00000>,
		      <0x4 0xf0000000 0x0 0x10000000>;
	};

	panel-edp0 {
		compatible = "simple-panel";
		backlight = <&backlight>;
		unprepare-delay-ms = <0x78>;
		enable-delay-ms = <0x78>;
		disable-delay-ms = <120>;
		prepare-delay-ms = <0x78>;
		enable-gpios = <&gpio1 RK_PA4 GPIO_ACTIVE_HIGH>;
		switch-gpios = <&gpio3 RK_PD5 GPIO_ACTIVE_HIGH>;
		power-supply = <&vcc3v3_lcd_n>;

		port {

			panel_in_edp0: endpoint {
				remote-endpoint = <&edp0_out_panel>;
			};
		};

		panel-timing {
			vback-porch = <71>;
			hsync-active = <0x00>;
			de-active = <0x00>;
			vfront-porch = <3>;
			hactive = <0x780>;
			clock-frequency = <152570000>;
			vsync-active = <0x00>;
			vactive = <1080>;
			vsync-len = <6>;
			hfront-porch = <48>;
			hsync-len = <32>;
			hback-porch = <192>;
			pixelclk-active = <0x00>;
		};
	};

	fan: pwm-fan {
		compatible = "pwm-fan";
		status = "okay";
		#cooling-cells = <2>;
		pwms = <&pwm3 0x00 0xc350 0x00>;
	};

	vcc_1v1_nldo_s3: regulator-vcc-1v1-nldo-s3 {
		compatible = "regulator-fixed";
		regulator-name = "vcc_1v1_nldo_s3";
		regulator-always-on;
		regulator-boot-on;
		regulator-min-microvolt = <1100000>;
		regulator-max-microvolt = <1100000>;
		vin-supply = <&vcc5v0_sys>;
	};

	vcc3v3_lcd_n: regulator-vcc3v3-lcd-n {
		compatible = "regulator-fixed";
		regulator-name = "vcc3v3_lcd0_n";
		regulator-boot-on;
		enable-active-high;
		gpio = <&gpio2 RK_PC1 GPIO_ACTIVE_HIGH>;
		vin-supply = <&vcc_1v8_s0>;
	};

	reserved-memory {
		ranges;

		cma {
			size = <0x00 0x800000>;
			reusable;
			linux,cma-default;
		};
	};

	rk_headset: rk-headset {
		compatible = "rockchip_headset";
		status = "disabled";
		io-channels = <&saradc 0x03>;
		pinctrl-names = "default";
		pinctrl-0 = <&hp_det>;
		headset_gpio = <&gpio1 RK_PD5 GPIO_ACTIVE_LOW>;
	};

	vbus5v0_typec: vbus5v0-typec {
		compatible = "regulator-fixed";
		gpio = <&gpio4 RK_PA1 GPIO_ACTIVE_HIGH>;
		regulator-min-microvolt = <5000000>;
		vin-supply = <&vcc5v0_usb>;
		enable-active-high;
		regulator-name = "vbus5v0_typec";
		pinctrl-names = "default";
		pinctrl-0 = <&typec5v_pwren>;
		regulator-max-microvolt = <5000000>;
	};

	vcc12v_dcin: vcc12v-dcin {
		compatible = "regulator-fixed";
		regulator-boot-on;
		regulator-min-microvolt = <12000000>;
		regulator-always-on;
		regulator-name = "vcc12v_dcin";
		regulator-max-microvolt = <12000000>;
	};

	vcc5v0_sys: vcc5v0-sys {
		compatible = "regulator-fixed";
		regulator-boot-on;
		regulator-min-microvolt = <5000000>;
		vin-supply = <&vcc12v_dcin>;
		regulator-always-on;
		regulator-name = "vcc5v0_sys";
		regulator-max-microvolt = <5000000>;
	};

	vcc5v0_usb: vcc5v0-usb {
		compatible = "regulator-fixed";
		regulator-boot-on;
		regulator-min-microvolt = <5000000>;
		vin-supply = <&vcc5v0_usbdcin>;
		regulator-always-on;
		regulator-name = "vcc5v0_usb";
		regulator-max-microvolt = <5000000>;
	};

	vcc5v0_USB30: vcc5v0-USB30 {
		compatible = "regulator-fixed";
		regulator-boot-on;
		gpio = <&gpio4 RK_PC6 GPIO_ACTIVE_HIGH>;
		regulator-min-microvolt = <5000000>;
		vin-supply = <&vcc5v0_usb>;
		enable-active-high;
		regulator-always-on;
		regulator-name = "vcc5v0_USB30";
		pinctrl-names = "default";
		pinctrl-0 = <&vcc5v0_USB30_en>;
		regulator-max-microvolt = <5000000>;
	};

	vcc5v0_usbdcin: vcc5v0-usbdcin {
		compatible = "regulator-fixed";
		regulator-boot-on;
		regulator-min-microvolt = <5000000>;
		vin-supply = <&vcc12v_dcin>;
		regulator-always-on;
		regulator-name = "vcc5v0_usbdcin";
		regulator-max-microvolt = <5000000>;
	};
};

&av1d {
	status = "okay";
};

&av1d_mmu {
	status = "okay";
};

&avsd {
	status = "okay";
};

&combphy0_ps {
	status = "okay";
};

&combphy1_ps {
	status = "okay";
};

&cpu_b0 {
	cpu-supply = <&vdd_cpu_big0_s0>;
	mem-supply = <&vdd_cpu_big0_mem_s0>;
};

&cpu_b1 {
	cpu-supply = <&vdd_cpu_big0_s0>;
	mem-supply = <&vdd_cpu_big0_mem_s0>;
};

&cpu_b2 {
	cpu-supply = <&vdd_cpu_big1_s0>;
	mem-supply = <&vdd_cpu_big1_mem_s0>;
};

&cpu_b3 {
	cpu-supply = <&vdd_cpu_big1_s0>;
	mem-supply = <&vdd_cpu_big1_mem_s0>;
};

&cpu_l0 {
	cpu-supply = <&vdd_cpu_lit_s0>;
	mem-supply = <&vdd_cpu_lit_mem_s0>;
};

&cpu_l1 {
	cpu-supply = <&vdd_cpu_lit_s0>;
	mem-supply = <&vdd_cpu_lit_mem_s0>;
};

&cpu_l2 {
	cpu-supply = <&vdd_cpu_lit_s0>;
	mem-supply = <&vdd_cpu_lit_mem_s0>;
};

&cpu_l3 {
	cpu-supply = <&vdd_cpu_lit_s0>;
	mem-supply = <&vdd_cpu_lit_mem_s0>;
};



&csi2_dcphy0 {
		status = "okay";

		ports {
			#address-cells = <1>;
			#size-cells = <0>;

			port@0 {
				#address-cells = <1>;
				#size-cells = <0>;
				reg = <0>;

				mipidcphy0_in_ucam0: endpoint@0 {
					reg = <0>;
					data-lanes = <1 2 3>;
					remote-endpoint = <&imx766_out>;
					bus-type = <1>;
				};
			};

			port@1 {
				#address-cells = <1>;
				#size-cells = <0>;
				reg = <1>;

				csidcphy0_out: endpoint@0 {
					reg = <0>;
					remote-endpoint = <&mipi0_csi2_input>;
				};
			};
		};
};

&csi2_dphy0 {
		status = "okay";
		rockchip,hw = <&csi2_dphy0_hw>;

		ports {
			#address-cells = <1>;
			#size-cells = <0>;

			port@0 {
				#address-cells = <1>;
				#size-cells = <0>;
				reg = <0>;

				mipidphy0_in_ucam0: endpoint@1 {
					reg = <1>;
					data-lanes = <1 2 3 4>;
					remote-endpoint = <&lt6911_out0>;
				};
			};

			port@1 {
				#address-cells = <1>;
				#size-cells = <0>;
				reg = <1>;

				csidphy0_out: endpoint@0 {
					reg = <0>;
					remote-endpoint = <&mipi2_csi2_input>;
				};
			};
		};
};

&dmc {
	center-supply = <&vdd_ddr_s0>;
	mem-supply = <&vdd_log_s0>;
};

&dp0 {
	status = "okay";

		ports {

			port@0 {
				endpoint@1 {
					status = "okay";
					remote-endpoint = <&vp1_out_dp0>;
				};
			};
		};
};

&edp0 {
		force-hpd;
	status = "okay";

		ports {

			port@0 {
				endpoint@2 {
					status = "okay";
					remote-endpoint = <&vp2_out_edp0>;
				};
			};

			port@1 {

				edp0_out_panel: endpoint {
					remote-endpoint = <&panel_in_edp0>;
				};
			};
		};
};

/*
 * Android uses ttyFIQ0 through fiq-debugger.  A normal Linux userspace
 * needs the 8250 driver on UART2/M0 so ttyS2 remains usable as console.
 */
&fiq_debugger {
	status = "disabled";
};

&gmac1 {
		snps,reset-gpio = <&gpio3 RK_PB7 GPIO_ACTIVE_LOW>;
		status = "okay";
		phy-handle = <&rgmii_phy>;
		local-mac-address = [aa 64 5f 7a a0 21];
		snps,mixed-burst;
		snps,reset-active-low;
		snps,mtl-tx-config = <&gmac1_mtl_tx_setup>;
		snps,tso;
		clock_in_out = "output";
		snps,mtl-rx-config = <&gmac1_mtl_rx_setup>;
		snps,axi-config = <&gmac1_stmmac_axi_setup>;
		rockchip,php_grf = <&php_grf>;
		snps,reset-delays-us = <0x00 0x4e20 0x186a0>;
		tx_delay = <0x43>;
		pinctrl-names = "default";
		pinctrl-0 = <&gmac1_miim &gmac1_tx_bus2 &gmac1_rx_bus2 &gmac1_rgmii_clk &gmac1_rgmii_bus>;
		phy-mode = "rgmii-rxid";

		mdio {

			rgmii_phy: phy@1 {
			};
		};

		tx-queues-config {
			snps,tx-queues-to-use = <2>;

			queue1 {
			};

			queue0 {
			};
		};

		stmmac-axi-config {
			snps,wr_osr_lmt = <4>;
			snps,blen = <0x00 0x00 0x00 0x00 0x10 0x08 0x04>;
			snps,rd_osr_lmt = <8>;
		};

		rx-queues-config {
			snps,rx-queues-to-use = <2>;

			queue1 {
			};

			queue0 {
			};
		};
};

&gpu {
	mali-supply = <&vdd_gpu_s0>;
	mem-supply = <&vdd_gpu_mem_s0>;
	status = "okay";
};

&hdmi1 {
	status = "okay";
		rockchip,vo1_grf = <&vo1_grf>;
		enable-gpios = <&gpio4 RK_PB2 GPIO_ACTIVE_HIGH>;
		pinctrl-names = "default";
		pinctrl-0 = <&hdmim2_tx1_cec &hdmim0_tx1_hpd &hdmim1_tx1_scl &hdmim1_tx1_sda>;

		ports {

			port@0 {

				endpoint@0 {
					status = "okay";
					remote-endpoint = <&vp0_out_hdmi1>;
				};
			};
		};
};

&hdptxphy0 {
	status = "okay";
};

&hdptxphy1 {
	status = "okay";
};

&i2c0 {
	status = "okay";
	pinctrl-names = "default";
	pinctrl-0 = <&i2c0m2_xfer>;

	vdd_cpu_big0_s0: vdd_cpu_big0_mem_s0: rk8602@42 {
		compatible = "rockchip,rk8602";
		reg = <0x42>;
		vin-supply = <&vcc5v0_sys>;
		regulator-compatible = "rk860x-reg";
		regulator-name = "vdd_cpu_big0_s0";
		regulator-min-microvolt = <550000>;
		regulator-max-microvolt = <1050000>;
		regulator-ramp-delay = <2300>;
		rockchip,suspend-voltage-selector = <1>;
		regulator-boot-on;
		regulator-always-on;
		regulator-state-mem {
			regulator-off-in-suspend;
		};
	};

	vdd_cpu_big1_s0: vdd_cpu_big1_mem_s0: rk8603@43 {
		compatible = "rockchip,rk8603", "rockchip,rk8602";
		reg = <0x43>;
		vin-supply = <&vcc5v0_sys>;
		regulator-compatible = "rk860x-reg";
		regulator-name = "vdd_cpu_big1_s0";
		regulator-min-microvolt = <550000>;
		regulator-max-microvolt = <1050000>;
		regulator-ramp-delay = <2300>;
		rockchip,suspend-voltage-selector = <1>;
		regulator-boot-on;
		regulator-always-on;
		regulator-state-mem {
			regulator-off-in-suspend;
		};
	};
};



&i2c1 {
	status = "okay";
	pinctrl-names = "default";
	pinctrl-0 = <&i2c1m2_xfer>;

	vdd_npu_s0: vdd_npu_mem_s0: rk8602@42 {
		compatible = "rockchip,rk8602";
		reg = <0x42>;
		vin-supply = <&vcc5v0_sys>;
		regulator-compatible = "rk860x-reg";
		regulator-name = "vdd_npu_s0";
		regulator-min-microvolt = <550000>;
		regulator-max-microvolt = <950000>;
		regulator-ramp-delay = <2300>;
		rockchip,suspend-voltage-selector = <1>;
		regulator-boot-on;
		regulator-always-on;
		regulator-state-mem {
			regulator-off-in-suspend;
		};
	};
};

&i2c2 {
		status = "okay";
		clock-frequency = <400000>;
		pinctrl-names = "default";
		pinctrl-0 = <&i2c2m4_xfer>;

		otp_eeprom: otp_eeprom@50 {
			compatible = "rk,otp_eeprom";
			reg = <0x50>;
			status = "okay";
		};

		dw9800w: dw9800w@c {
			compatible = "dongwoon,dw9800w";
			reg = <0x0c>;
			rockchip,vcm-rated-current = <805>;
			rockchip,vcm-step-mode = <1>;
			status = "okay";
			rockchip,vcm-start-current = <205>;
			rockchip,camera-module-index = <0>;
			power-gpios = <&gpio1 RK_PD2 GPIO_ACTIVE_HIGH>;
			rockchip,vcm-t-div = <1>;
			rockchip,vcm-max-current = <1023>;
			rockchip,camera-module-facing = "back";
			rockchip,vcm-t-src = <37>;
		};

		imx766: imx766@10 {
			compatible = "sony,imx766";
			reg = <0x10>;
			status = "okay";
			clocks = <&cru CLK_MIPI_CAMARAOUT_M1>;
			clock-names = "xvclk";
			lens-focus = <&dw9800w>;
			rockchip,camera-module-index = <0>;
			rockchip,camera-module-lens-name = "IR0147-50IRC-8M-F20";
			eeprom-ctrl = <&otp_eeprom>;
			rockchip,camera-module-name = "CMK-OT2022-PX1";
			power-gpios = <&gpio1 RK_PD2 GPIO_ACTIVE_HIGH>;
			rockchip,spd-id = <1>;
			reset-gpios = <&gpio1 RK_PA3 GPIO_ACTIVE_HIGH>;
			pinctrl-names = "default";
			rockchip,camera-module-facing = "back";
			pinctrl-0 = <&mipim0_camera1_clk>;
			pwdn-gpios = <&gpio1 RK_PA2 GPIO_ACTIVE_HIGH>;

			port {

				imx766_out: endpoint {
					data-lanes = <1 2 3>;
					remote-endpoint = <&mipidcphy0_in_ucam0>;
					bus-type = <1>;
				};
			};
		};
};

&i2c3 {
		status = "okay";
		clock-frequency = <100000>;
		pinctrl-names = "default";
		pinctrl-0 = <&i2c3m0_xfer>;

		lt6911: lt6911@2b {
			compatible = "lontium,lt6911uxc";
			reg = <0x2b>;
			status = "okay";
			interrupt-parent = <&gpio1>;
			interrupts = <RK_PA7 IRQ_TYPE_LEVEL_LOW>;
			rockchip,camera-module-index = <0>;
			rockchip,camera-module-lens-name = "IR0147-50IRC-8M-F20";
			rockchip,camera-module-name = "CMK-OT2022-PX1";
			power-gpios = <&gpio1 RK_PB0 GPIO_ACTIVE_HIGH>;
			hpd-ctl-gpios = <&gpio3 RK_PD4 GPIO_ACTIVE_HIGH>;
			reset-gpios = <&gpio2 RK_PC3 GPIO_ACTIVE_HIGH>;
			pinctrl-names = "default";
			rockchip,camera-module-facing = "back";
			pinctrl-0 = <&lt6911_default>;
			plugin-det-gpios = <&gpio1 RK_PC6 GPIO_ACTIVE_LOW>;

			port {

				lt6911_out0: endpoint {
					data-lanes = <1 2 3 4>;
					remote-endpoint = <&mipidphy0_in_ucam0>;
				};
			};
		};
};

&i2c5 {
	status = "okay";
	clock-frequency = <100000>;
	pinctrl-names = "default";
	pinctrl-0 = <&i2c5m0_xfer>;

	gt9xx: gt9xx@14 {
		compatible = "goodix,gt9xx";
		reg = <0x14>;
		interrupt-parent = <&gpio3>;
		interrupts = <RK_PC0 IRQ_TYPE_LEVEL_LOW>;
		irq-gpios = <&gpio3 RK_PC0 GPIO_ACTIVE_LOW>;
		reset-gpios = <&gpio3 RK_PC1 GPIO_ACTIVE_HIGH>;
		pinctrl-names = "default";
		pinctrl-0 = <&gt9xx_gpios>;
		touchscreen-size-x = <1920>;
		touchscreen-size-y = <1080>;
		status = "okay";
	};
};

/* ==== restored: endpoint / supply / chip targets ==== */

&i2c6 {
		status = "okay";
		clock-frequency = <400000>;
		pinctrl-names = "default";
		pinctrl-0 = <&i2c6m0_xfer>;

		hym8563@32 {
			compatible = "whwave,sd3078";
			reg = <0x32>;
			status = "okay";
			#clock-cells = <0>;
			interrupt-parent = <&gpio0>;
			interrupts = <RK_PB0 IRQ_TYPE_LEVEL_LOW>;
			clock-frequency = <32768>;
			RTC1800-supply = <&vcc_3v3_s3>;
			wakeup-source;
			clock-output-names = "hym8563";
			pinctrl-names = "default";
			pinctrl-0 = <&hym8563_int>;
		};

		husb311@4e {
			compatible = "hynetek,husb311";
			reg = <0x4e>;
			status = "okay";
			interrupt-parent = <&gpio0>;
			interrupts = <RK_PD3 IRQ_TYPE_LEVEL_LOW>;
			vbus-supply = <&vbus5v0_typec>;
			pinctrl-names = "default";
			pinctrl-0 = <&usbc0_int>;

			connector {
				data-role = "dual";
				source-pdos = <0x401912c>;
				label = "USB-C";
				power-role = "dual";
				try-power-role = "sink";
				sink-pdos = <0x4019064>;
				op-sink-microwatt = <0xf4240>;

				ports {
					#address-cells = <1>;
					#size-cells = <0>;

					port@0 {
						#address-cells = <1>;
						#size-cells = <0>;
						reg = <0>;

						usbc0_orien_sw: endpoint {
							remote-endpoint = <&usbdp_phy0_orientation_switch>;
						};
					};

					port@1 {
						#address-cells = <1>;
						#size-cells = <0>;
						reg = <1>;

						dp_altmode_mux: endpoint {
							remote-endpoint = <&usbdp_phy0_dp_altmode_mux>;
						};
					};
				};

				altmodes {
					#address-cells = <1>;
					#size-cells = <0>;

					altmode@0 {
						reg = <0>;
						vdo = <0xffffffff>;
						svid = <0xff01>;
					};
				};
			};

			ports {
				#address-cells = <1>;
				#size-cells = <0>;

				port@0 {
					#address-cells = <1>;
					#size-cells = <0>;
					reg = <0>;

					usbc0_role_sw: endpoint@0 {
						reg = <0>;
						remote-endpoint = <&dwc3_0_role_switch>;
					};
				};
			};
		};
};

&i2c7 {
	status = "okay";

	es8388: es8388@11 {
		status = "okay";
		#sound-dai-cells = <0>;
		compatible = "everest,es8388", "everest,es8323";
		reg = <0x11>;
		clocks = <&mclkout_i2s0>;
		clock-names = "mclk";
		assigned-clocks = <&mclkout_i2s0>;
		assigned-clock-rates = <12288000>;
		pinctrl-names = "default";
		pinctrl-0 = <&i2s0_mclk>;
	};
};

&i2s0_8ch {
	status = "okay";
	pinctrl-names = "default";
	pinctrl-0 = <&i2s0_lrck &i2s0_sclk &i2s0_sdi0 &i2s0_sdo0>;
};

&i2s5_8ch {
	status = "okay";
};

&i2s6_8ch {
	status = "okay";
};

&i2s7_8ch {
	status = "okay";
};

&iep {
	status = "okay";
};

&iep_mmu {
	status = "okay";
};

&isp0_mmu {
	status = "okay";
};

&isp1_mmu {
	status = "okay";
};

&jpegd {
	status = "okay";
};

&jpegd_mmu {
	status = "okay";
};

&jpege0 {
	status = "okay";
};

&jpege0_mmu {
	status = "okay";
};

&jpege1 {
	status = "okay";
};

&jpege1_mmu {
	status = "okay";
};

&jpege2 {
	status = "okay";
};

&jpege2_mmu {
	status = "okay";
};

&jpege3 {
	status = "okay";
};

&jpege3_mmu {
	status = "okay";
};

&jpege_ccu {
	status = "okay";
};

&mipi0_csi2 {
		status = "okay";

		ports {
			#address-cells = <1>;
			#size-cells = <0>;

			port@0 {
				#address-cells = <1>;
				#size-cells = <0>;
				reg = <0>;

				mipi0_csi2_input: endpoint@1 {
					reg = <1>;
					remote-endpoint = <&csidcphy0_out>;
				};
			};

			port@1 {
				#address-cells = <1>;
				#size-cells = <0>;
				reg = <1>;

				mipi0_csi2_output: endpoint@0 {
					reg = <0>;
					remote-endpoint = <&cif_mipi_in0>;
				};
			};
		};
};

&mipi2_csi2 {
		status = "okay";

		ports {
			#address-cells = <1>;
			#size-cells = <0>;

			port@0 {
				#address-cells = <1>;
				#size-cells = <0>;
				reg = <0>;

				mipi2_csi2_input: endpoint@1 {
					reg = <1>;
					remote-endpoint = <&csidphy0_out>;
				};
			};

			port@1 {
				#address-cells = <1>;
				#size-cells = <0>;
				reg = <1>;

				mipi2_csi2_output: endpoint@0 {
					reg = <0>;
					remote-endpoint = <&cif_mipi2_in0>;
				};
			};
		};
};

&mpp_srv {
	status = "okay";
};

&pcie2x1l0 {
		status = "okay";
		/* The reference-board reset GPIO is not wired on this board. */
		/delete-property/ reset-gpios;
};

&pinctrl {
	gt9xx {
		gt9xx_gpios: gt9xx-gpios {
			rockchip,pins = <3 RK_PC1 RK_FUNC_GPIO &pcfg_pull_up>,
					<3 RK_PC0 RK_FUNC_GPIO &pcfg_pull_up>;
		};
	};

	buttons {
		gpiobtn: gpiobtn {
			rockchip,pins = <2 RK_PB0 RK_FUNC_GPIO &pcfg_pull_up>,
				<2 RK_PB1 RK_FUNC_GPIO &pcfg_pull_up>,
				<2 RK_PB2 RK_FUNC_GPIO &pcfg_pull_up>,
				<2 RK_PB3 RK_FUNC_GPIO &pcfg_pull_up>;
		};
	};

	usb-typec {
		typec5v_pwren: typec5v-pwren {
			rockchip,pins = <4 RK_PA1 RK_FUNC_GPIO &pcfg_pull_none>;
		};
		usbc0_int: usbc0-int {
			rockchip,pins = <0 RK_PD3 RK_FUNC_GPIO &pcfg_pull_up>;
		};
	};

	hym8563 {
		hym8563_int: hym8563-int {
			rockchip,pins = <0 RK_PB0 RK_FUNC_GPIO &pcfg_pull_up>;
		};
	};

	lt6911 {
		lt6911_default: lt6911default {
			rockchip,pins = <1 RK_PA7 RK_FUNC_GPIO &pcfg_pull_up>,
				<1 RK_PB0 RK_FUNC_GPIO &pcfg_pull_down>,
				<2 RK_PC3 RK_FUNC_GPIO &pcfg_pull_down>,
				<1 RK_PC6 RK_FUNC_GPIO &pcfg_pull_none>,
				<3 RK_PD4 RK_FUNC_GPIO &pcfg_pull_down>;
		};
	};

	gpio-func {
		tsadc_gpio_func: tsadc-gpio-func {
			rockchip,pins = <0 RK_PA1 RK_FUNC_GPIO &pcfg_pull_none>;
		};
	};

	usb {
		vcc5v0_USB30_en: vcc5v0-USB30-en {
			rockchip,pins = <4 RK_PC6 RK_FUNC_GPIO &pcfg_pull_none>;
		};
	};

	headphone {
		hp_det: hp-det {
			rockchip,pins = <1 RK_PC4 RK_FUNC_GPIO &pcfg_pull_none>;
		};
	};

	backlight_ctl {
		backlight_en: backlight-en {
			rockchip,pins = <2 RK_PC1 RK_FUNC_GPIO &pcfg_pull_down>;
		};
	};

	uart9 {
		uart9m0_rtsn: uart9m0-rtsn {
			rockchip,pins = <4 RK_PC4 10 &pcfg_pull_none>;
		};
		uart9m0_xfer: uart9m0-xfer {
			rockchip,pins = <2 RK_PC4 10 &pcfg_pull_up>,
				<2 RK_PC2 10 &pcfg_pull_up>;
		};
		uart9m0_ctsn: uart9m0-ctsn {
			rockchip,pins = <4 RK_PC5 10 &pcfg_pull_none>;
		};
	};
};

&pwm1 {
	status = "okay";
};

&pwm3 {
	status = "okay";
};

&rga2 {
	status = "okay";
};

&rga3_0_mmu {
	status = "okay";
};

&rga3_1_mmu {
	status = "okay";
};

&rga3_core0 {
	status = "okay";
};

&rga3_core1 {
	status = "okay";
};

&rkcif {
	status = "okay";
};

&rkcif_mipi_lvds {
		status = "okay";
		rockchip,hw = <&rkcif>;

		port {

			cif_mipi_in0: endpoint {
				remote-endpoint = <&mipi0_csi2_output>;
			};
		};
};

&rkcif_mipi_lvds2 {
		status = "okay";
		rockchip,hw = <&rkcif>;

		port {

			cif_mipi2_in0: endpoint {
				remote-endpoint = <&mipi2_csi2_output>;
			};
		};
};

&rkcif_mipi_lvds_sditf {
		status = "okay";
		rockchip,cif = <&rkcif_mipi_lvds>;

		port {

			mipi_lvds_sditf: endpoint {
				remote-endpoint = <&isp0_vir0>;
			};
		};
};

&rkcif_mmu {
	status = "okay";
};

&rkisp0 {
	status = "okay";
};

&rkisp0_vir0 {
		status = "okay";
		rockchip,hw = <&rkisp0>;

		port {
			#address-cells = <1>;
			#size-cells = <0>;

			isp0_vir0: endpoint@0 {
				reg = <0>;
				remote-endpoint = <&mipi_lvds_sditf>;
			};
		};
};

&rkisp1 {
	status = "okay";
};

&rkisp1_vir0 {
		status = "okay";
		rockchip,hw = <&rkisp1>;

		port {
			#address-cells = <1>;
			#size-cells = <0>;

			endpoint@0 {
				reg = <0>;
				remote-endpoint = <&mipi_lvds_sditf>;
			};
		};
};

&rknpu {
	rknpu-supply = <&vdd_npu_s0>;
	mem-supply = <&vdd_npu_mem_s0>;
	status = "okay";
};

&rknpu_mmu {
	status = "okay";
};

&rkvdec0 {
	status = "okay";
};

&rkvdec0_mmu {
	status = "okay";
};

&rkvdec1 {
	status = "okay";
};

&rkvdec1_mmu {
	status = "okay";
};

&rkvdec_ccu {
	status = "okay";
};

&rkvenc0 {
	status = "okay";
};

&rkvenc0_mmu {
	status = "okay";
};

&rkvenc1 {
	status = "okay";
};

&rkvenc1_mmu {
	status = "okay";
};

&rkvenc_ccu {
	status = "okay";
};

&rkvtunnel {
	status = "okay";
};

&route_dp0 {
	status = "okay";
};

&route_edp0 {
	status = "okay";
};

&route_hdmi1 {
	status = "okay";
};

&saradc {
	vref-supply = <&vcc_1v8_s0>;
	status = "okay";
};

&sata0 {
	status = "okay";
};

/* ==== Armbian rk-6.1-rkr7.2 boot and status audit ==== */

&sdhci {
	status = "okay";
	bus-width = <8>;
	no-sd;
	no-sdio;
	non-removable;
	mmc-hs400-1_8v;
	mmc-hs400-enhanced-strobe;
};

/* DP0 sound uses SPDIF TX2 in the factory DTB. */
&spdif_tx2 {
	status = "okay";
};

&spi2 {
	pinctrl-names = "default";
	pinctrl-0 = <&spi2m2_cs0 &spi2m2_pins>;

	rk806single@0 {
		/* 本机 PMIC 差异：reset-func 用默认 1；DVS 引脚需要下拉 */
		pinctrl-names = "default", "pmic-power-off";
		pinctrl-0 = <&pmic_pins &rk806_dvs1_null &rk806_dvs2_null &rk806_dvs3_null>;
		pinctrl-1 = <&rk806_dvs1_pwrdn>;
		/* 与 rk3588-rk806-single.dtsi 的差异项 */
		low_voltage_threshold = <3000>;
		shutdown_voltage_threshold = <2700>;
		shutdown_temperture_threshold = <160>;
		hotdie_temperture_threshold = <115>;

		pinctrl_rk806 {
			gpio-controller;
			#gpio-cells = <0x02>;
			rk806_dvs3_null: rk806_dvs3_null {
				function = "pin_fun0";
				pins = "gpio_pwrctrl3";
			};
			rk806_dvs3_rst {
				function = "pin_fun3";
				pins = "gpio_pwrctrl3";
			};
			rk806_dvs1_null: rk806_dvs1_null {
				function = "pin_fun0";
				pins = "gpio_pwrctrl2";
			};
			rk806_dvs1_slp {
				function = "pin_fun1";
				pins = "gpio_pwrctrl1";
			};
			rk806_dvs2_null: rk806_dvs2_null {
				function = "pin_fun0";
				pins = "gpio_pwrctrl2";
			};
			rk806_dvs2_rst {
				function = "pin_fun3";
				pins = "gpio_pwrctrl2";
			};
			rk806_dvs2_gpio {
				function = "pin_fun5";
				pins = "gpio_pwrctrl2";
			};
			rk806_dvs3_gpio {
				function = "pin_fun5";
				pins = "gpio_pwrctrl3";
			};
			rk806_dvs2_slp {
				function = "pin_fun1";
				pins = "gpio_pwrctrl2";
			};
			rk806_dvs1_pwrdn: rk806_dvs1_pwrdn {
				function = "pin_fun2";
				pins = "gpio_pwrctrl1";
			};
			rk806_dvs1_rst {
				function = "pin_fun3";
				pins = "gpio_pwrctrl1";
			};
			rk806_dvs3_dvs {
				function = "pin_fun4";
				pins = "gpio_pwrctrl3";
			};
			rk806_dvs3_pwrdn {
				function = "pin_fun2";
				pins = "gpio_pwrctrl3";
			};
			rk806_dvs2_dvs {
				function = "pin_fun4";
				pins = "gpio_pwrctrl2";
			};
			rk806_dvs3_slp {
				function = "pin_fun1";
				pins = "gpio_pwrctrl3";
			};
			rk806_dvs2_pwrdn {
				function = "pin_fun2";
				pins = "gpio_pwrctrl2";
			};
		};

		regulators {
			vdd_gpu_s0: vdd_gpu_mem_s0: DCDC_REG1 {
				regulator-enable-ramp-delay = <0>;
			};

			vdd_cpu_lit_s0: vdd_cpu_lit_mem_s0: DCDC_REG2 {
				/delete-property/ regulator-init-microvolt;
			};

			vdd_log_s0: DCDC_REG3 {
				regulator-max-microvolt = <750000>;
			};
		};
	};
};

&tsadc {
	status = "okay";
};

&u2phy0 {
	status = "okay";
};

&u2phy0_otg {
	status = "okay";
};

&u2phy1 {
	status = "okay";
};

&u2phy1_otg {
	status = "okay";
};

&u2phy2 {
	status = "okay";
};

&u2phy2_host {
	status = "okay";
};

&u2phy3 {
	status = "okay";
};

&u2phy3_host {
	status = "okay";
};

&uart2 {
	status = "okay";
	pinctrl-names = "default";
	pinctrl-0 = <&uart2m0_xfer>;
};

&uart9 {
	status = "okay";
};

&usb_host0_ehci {
	status = "okay";
};

&usb_host0_ohci {
	status = "okay";
};

&usb_host1_ehci {
	status = "okay";
};

&usb_host1_ohci {
	status = "okay";
};

&usbdp_phy0 {
		status = "okay";
		rockchip,usbdpphy-grf = <&usbdpphy0_grf>;
		rockchip,usb-grf = <&usb_grf>;
		sbu2-dc-gpios = <&gpio4 RK_PA7 GPIO_ACTIVE_HIGH>;
		svid = <0xff01>;
		orientation-switch;
		sbu1-dc-gpios = <&gpio4 RK_PA6 GPIO_ACTIVE_HIGH>;
		rockchip,vo-grf = <&vo0_grf>;
		rockchip,u2phy-grf = <&usb2phy0_grf>;

		u3-port {
			status = "okay";
		};

		dp-port {
			status = "okay";
		};

		port {
			#address-cells = <1>;
			#size-cells = <0>;

			usbdp_phy0_orientation_switch: endpoint@0 {
				reg = <0>;
				remote-endpoint = <&usbc0_orien_sw>;
			};

			usbdp_phy0_dp_altmode_mux: endpoint@1 {
				reg = <1>;
				remote-endpoint = <&dp_altmode_mux>;
			};
		};
};

&usbdp_phy1 {
		status = "okay";
		rockchip,dp-lane-mux = <0x02 0x03>;
		rockchip,usbdpphy-grf = <&usbdpphy1_grf>;
		rockchip,usb-grf = <&usb_grf>;
		rockchip,vo-grf = <&vo0_grf>;
		rockchip,u2phy-grf = <&usb2phy1_grf>;

		u3-port {
			status = "okay";
		};

		dp-port {
			status = "disabled";
		};
};

&usbdrd3_0 {
		status = "okay";
		ranges;

		usb@fc000000 {
			status = "okay";
			snps,dis-u1-entry-quirk;
			snps,dis_enblslpm_quirk;
			quirk-skip-phy-init;
			snps,dis-u2-freeclk-exists-quirk;
			snps,dis-del-phy-power-chg-quirk;
			usb-role-switch;
			snps,dis-tx-ipgap-linecheck-quirk;
			snps,dis-u2-entry-quirk;
			dr_mode = "otg";
			phy_type = "utmi_wide";

			port {
				#address-cells = <1>;
				#size-cells = <0>;

				dwc3_0_role_switch: endpoint@0 {
					reg = <0>;
					remote-endpoint = <&usbc0_role_sw>;
				};
			};
		};
};

&usbdrd3_1 {
	status = "okay";
};

&usbdrd_dwc3_1 {
	status = "okay";
};

&vdpu {
	status = "okay";
};

&vdpu_mmu {
	status = "okay";
};

&vepu {
	status = "okay";
};

&vop {
	status = "okay";
};

&vop_mmu {
	status = "okay";
};

&vp0 {
	rockchip,plane-mask = <(1 << ROCKCHIP_VOP2_CLUSTER0 |
				1 << ROCKCHIP_VOP2_ESMART0)>;
	rockchip,primary-plane = <ROCKCHIP_VOP2_ESMART0>;
};

&vp1 {
	rockchip,plane-mask = <(1 << ROCKCHIP_VOP2_CLUSTER1 |
				1 << ROCKCHIP_VOP2_ESMART1)>;
	rockchip,primary-plane = <ROCKCHIP_VOP2_ESMART1>;
};

&vp2 {
	rockchip,plane-mask = <(1 << ROCKCHIP_VOP2_CLUSTER2 |
				1 << ROCKCHIP_VOP2_ESMART2)>;
	rockchip,primary-plane = <ROCKCHIP_VOP2_ESMART2>;
};

&vp3 {
	rockchip,plane-mask = <(1 << ROCKCHIP_VOP2_CLUSTER3 |
				1 << ROCKCHIP_VOP2_ESMART3)>;
	rockchip,primary-plane = <ROCKCHIP_VOP2_ESMART3>;
};

